## examples/cloud_services/google_tts/main/Kconfig.projbuild
```kconfig
menu "Example Configuration"

config WIFI_SSID
    string "WiFi SSID"
	default "myssid"
	help
		SSID (network name) for the example to connect to.

config WIFI_PASSWORD
    string "WiFi Password"
	default "mypassword"
	help
		WiFi password (WPA or WPA2) for the example to use.
		Can be left blank if the network has no security set.

config GOOGLE_API_KEY
    string "Google Cloud API Key"
    default "api-key"
    help
        Google Cloud API Key
        The key may be obtained from https://cloud.google.com/docs/authentication/api-keys

config TRANSLATE_LANG_FROM
    string "Language to translate from, i.e. Speaker's language code"
    default "ru-RU"
    help
        Speech recognition and translation language code
        Refer to the docs for available options at https://cloud.google.com/speech-to-text/docs/languages

config TRANSLATE_LANG_TO
    string "Language to translate to"
    default "en-US"
    help
        Translation language code
        Refer to the docs for available options at https://cloud.google.com/speech-to-text/docs/languages

config TTS_VOICE
    string "Text-to-speech voice"
    default "en-US-Wavenet-C"
    help
        Text to speech voice
        Refer to the docs for available options at https://cloud.google.com/text-to-speech/docs/voices

endmenu
```
